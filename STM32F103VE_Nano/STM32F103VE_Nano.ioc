# file: STM32F103VE_Nano.ioc
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Mcu.Family=STM32F1
Mcu.Name=STM32F103V(C-D-E)Tx
Mcu.Package=LQFP100
NVIC.PriorityGroup=NVIC_PRIORITYGROUP_4
PA13.Mode=Serial_Wire
PA13.Signal=SYS_JTMS-SWDIO
PA14.Mode=Serial_Wire
PA14.Signal=SYS_JTCK-SWCLK
PB5.PinState=GPIO_PIN_SET
PB5.Signal=GPIO_Output
ProjectManager.HeapSize=0x200
ProjectManager.StackSize=0x400
ProjectManager.TargetToolchain=MDK-ARM V5
RCC.AHBFreq_Value=64000000
RCC.APB1CLKDivider=RCC_HCLK_DIV2
RCC.APB1Freq_Value=32000000
RCC.APB1TimFreq_Value=64000000
RCC.APB2Freq_Value=64000000
RCC.APB2TimFreq_Value=64000000
RCC.HCLKFreq_Value=64000000
RCC.PLLMUL=RCC_PLL_MUL16
RCC.SYSCLKFreq_VALUE=64000000
RCC.SYSCLKSource=RCC_SYSCLKSOURCE_PLLCLK
RCC.USBFreq_Value=64000000
RealThread.RT-Thread.3.1.2.RTAaThreadCcRTOSJjdeviceOodrivers=true
RealThread.RT-Thread.3.1.2.RTAaThreadCcRTOSJjkernel=true
RealThread.RT-Thread.3.1.2.RTAaThreadCcRTOSJjshell=true
RealThread.RT-Thread.3.1.2.RTOSJjRTAaThread.cmp_version0=3.1.2
RealThread.RT-Thread.3.1.2.RTOSJjRTAaThread.cmp_version1=3.1.2
RealThread.RT-Thread.3.1.2.RTOSJjRTAaThread.cmp_version2=3.1.2
RealThread.RT-Thread.3.1.2.RTOSJjRTAaThread.component0=RTOS
RealThread.RT-Thread.3.1.2.RTOSJjRTAaThread.component1=RTOS
RealThread.RT-Thread.3.1.2.RTOSJjRTAaThread.component2=RTOS
RealThread.RT-Thread.3.1.2.RTOSJjRTAaThread.description0=rt-thread,rt-thread kernel files
RealThread.RT-Thread.3.1.2.RTOSJjRTAaThread.description1=rt-thread,rt-thread device drivers files(abandoned component\uFF0Creserved for compatibility)
RealThread.RT-Thread.3.1.2.RTOSJjRTAaThread.description2=rt-thread,rt-thread finsh
RealThread.RT-Thread.3.1.2.RTOSJjRTAaThread.diagnostic0=This component should operate correctly.
RealThread.RT-Thread.3.1.2.RTOSJjRTAaThread.diagnostic1=This component should operate correctly.
RealThread.RT-Thread.3.1.2.RTOSJjRTAaThread.diagnostic2=This component should operate correctly.
RealThread.RT-Thread.3.1.2.RTOSJjRTAaThread.group0=kernel
RealThread.RT-Thread.3.1.2.RTOSJjRTAaThread.group1=device drivers
RealThread.RT-Thread.3.1.2.RTOSJjRTAaThread.group2=shell
RealThread.RT-Thread.3.1.2.RTOSJjRTAaThread.paramName0=RTAaThreadCcRTOSJjkernel
RealThread.RT-Thread.3.1.2.RTOSJjRTAaThread.paramName1=RTAaThreadCcRTOSJjdeviceOodrivers
RealThread.RT-Thread.3.1.2.RTOSJjRTAaThread.paramName2=RTAaThreadCcRTOSJjshell
RealThread.RT-Thread.3.1.2.RTOSJjRTAaThread.sevirity0=none
RealThread.RT-Thread.3.1.2.RTOSJjRTAaThread.sevirity1=none
RealThread.RT-Thread.3.1.2.RTOSJjRTAaThread.sevirity2=none
RealThread.RT-Thread.3.1.2.RTOSJjRTAaThread_bundle=RT-Thread
RealThread.RT-Thread.3.1.2.RTOSJjRTAaThread_class=RTOS
RealThread.RT-Thread.3.1.2.RTOSJjRTAaThread_name=RT-Thread
RealThread.RT-Thread.3.1.2.RTOSJjRTAaThread_size=3
RealThread.RT-Thread.3.1.2.RTOSJjRTAaThread_vendor=RealThread
RealThread.RT-Thread.3.1.2.RTOSJjRTAaThread_version=3.1.2
RealThread.RT-Thread.3.1.2_CubeMXJjrtAathread_RteComponentsize=0
RealThread.RT-Thread.3.1.2_MwName0=RT-Thread
RealThread.RT-Thread.3.1.2_NumberOfMw=1
RealThread.RT-Thread.3.1.2_RTOSJjRTAaThread_RteComponent0=\          \#define RTE_USING_DEVICE
RealThread.RT-Thread.3.1.2_RTOSJjRTAaThread_RteComponent1=\          \#define RTE_USING_FINSH
RealThread.RT-Thread.3.1.2_RTOSJjRTAaThread_RteComponentsize=2
RealThread.RT-Thread.3.1.2_description=RT-Thread Software Components
RealThread.RT-Thread.3.1.2_license=License.txt
RealThread.RT-Thread.3.1.2_supportedCore=Cortex-M0;Cortex-M0+;Cortex-M3;Cortex-M4;Cortex-M7;
VP_RealThread.RT-Thread_VS_RTOSJjRTAaThread_3.1.2.Mode=RTOSJjRTAaThread
board=custom

// file: Src/main.c
/* USER CODE BEGIN Header */
/**
  ******************************************************************************
  * @file           : main.c
  * @brief          : Main program body
  ******************************************************************************
  * @attention
  *
  * <h2><center>&copy; Copyright (c) 2019 STMicroelectronics.
  * All rights reserved.</center></h2>
  *
  * This software component is licensed by ST under Ultimate Liberty license
  * SLA0044, the "License"; You may not use this file except in compliance with
  * the License. You may obtain a copy of the License at:
  *                             www.st.com/SLA0044
  *
  ******************************************************************************
  */
/* USER CODE END Header */

#include "main.h"
#include "app_rtthread.h"

/* USER CODE BEGIN Includes */
#include "includes.h"
/* USER CODE END Includes */

void SystemClock_Config(void);
static void MX_GPIO_Init(void);

int main(void)
{

  /* MCU Configuration--------------------------------------------------------*/

  /* Reset of all peripherals, Initializes the Flash interface and the Systick. */
  HAL_Init();

  /* Configure the system clock */
  SystemClock_Config();

  /* Initialize all configured peripherals */
  MX_GPIO_Init();
  MX_RT_Thread_Init();
  /* USER CODE BEGIN 2 */
  User_Initialize();
  /* USER CODE END 2 */

  /* Infinite loop */
  /* USER CODE BEGIN WHILE */
  while (1)
  {
    User_Loop();
    /* USER CODE END WHILE */

  MX_RT_Thread_Process();
  }
}

void SystemClock_Config(void)
{
  RCC_OscInitTypeDef RCC_OscInitStruct = {0};
  RCC_ClkInitTypeDef RCC_ClkInitStruct = {0};

  /** Initializes the CPU, AHB and APB busses clocks
  */
  RCC_OscInitStruct.OscillatorType = RCC_OSCILLATORTYPE_HSI;
  RCC_OscInitStruct.HSIState = RCC_HSI_ON;
  RCC_OscInitStruct.HSICalibrationValue = RCC_HSICALIBRATION_DEFAULT;
  RCC_OscInitStruct.PLL.PLLState = RCC_PLL_ON;
  RCC_OscInitStruct.PLL.PLLSource = RCC_PLLSOURCE_HSI_DIV2;
  RCC_OscInitStruct.PLL.PLLMUL = RCC_PLL_MUL16;
  if (HAL_RCC_OscConfig(&RCC_OscInitStruct) != HAL_OK)
  {
    Error_Handler();
  }
  /** Initializes the CPU, AHB and APB busses clocks
  */
  RCC_ClkInitStruct.ClockType = RCC_CLOCKTYPE_HCLK|RCC_CLOCKTYPE_SYSCLK
                              |RCC_CLOCKTYPE_PCLK1|RCC_CLOCKTYPE_PCLK2;
  RCC_ClkInitStruct.SYSCLKSource = RCC_SYSCLKSOURCE_PLLCLK;
  RCC_ClkInitStruct.AHBCLKDivider = RCC_SYSCLK_DIV1;
  RCC_ClkInitStruct.APB1CLKDivider = RCC_HCLK_DIV2;
  RCC_ClkInitStruct.APB2CLKDivider = RCC_HCLK_DIV1;

  if (HAL_RCC_ClockConfig(&RCC_ClkInitStruct, FLASH_LATENCY_2) != HAL_OK)
  {
    Error_Handler();
  }
}

static void MX_GPIO_Init(void)
{
  GPIO_InitTypeDef GPIO_InitStruct = {0};

  /* GPIO Ports Clock Enable */
  __HAL_RCC_GPIOA_CLK_ENABLE();
  __HAL_RCC_GPIOB_CLK_ENABLE();

  /*Configure GPIO pin Output Level */
  HAL_GPIO_WritePin(GPIOB, GPIO_PIN_5, GPIO_PIN_SET);

  /*Configure GPIO pin : PB5 */
  GPIO_InitStruct.Pin = GPIO_PIN_5;
  GPIO_InitStruct.Mode = GPIO_MODE_OUTPUT_PP;
  GPIO_InitStruct.Pull = GPIO_NOPULL;
  GPIO_InitStruct.Speed = GPIO_SPEED_FREQ_LOW;
  HAL_GPIO_Init(GPIOB, &GPIO_InitStruct);

}

void Error_Handler(void)
{
}

/************************ (C) COPYRIGHT STMicroelectronics *****END OF FILE****/
